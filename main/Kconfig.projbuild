## main/Kconfig.projbuild
```kconfig
menu "NIBE Gateway Configuration"

    config NGW_WIFI_SSID
        string "WiFi SSID"

    config NGW_WIFI_PASSWORD
        string "WiFi Password"

    config NGW_UART_RS485_PORT_NUM
        int "UART port for RS485"
        range 0 2 if IDF_TARGET_ESP32
        default 2 if IDF_TARGET_ESP32
        range 0 1 if IDF_TARGET_ESP32S2
        default 1 if IDF_TARGET_ESP32S2
        help
            UART communication port to the RS485 transceiver.

    config NGW_UART_RS485_RX
        int "UART RX pin for RS485"
        range 0 34 if IDF_TARGET_ESP32
        default 22 if IDF_TARGET_ESP32
        range 0 46 if IDF_TARGET_ESP32S2
        default 19 if IDF_TARGET_ESP32S2
        help
            GPIO number for UART RX pin. See UART documentation for more information
            about available pin numbers for UART.

    config NGW_UART_RS485_TX
        int "UART TX pin for RS485"
        range 0 34 if IDF_TARGET_ESP32
        default 23 if IDF_TARGET_ESP32
        range 0 46 if IDF_TARGET_ESP32S2
        default 20 if IDF_TARGET_ESP32S2
        help
            GPIO number for UART TX pin. See UART documentation for more information
            about available pin numbers for UART.

    config NGW_UART_RS485_RTS
        int "UART RTS pin for RS485"
        range -1 34 if IDF_TARGET_ESP32
        range -1 46 if IDF_TARGET_ESP32S2
        default 18
        help
            GPIO number for UART RTS pin. This pin is connected to ~RE/DE pin of the RS485
            transceiver to switch direction. Set to -1 if the transceiver doesn't need it.

    config NGW_MODBUS_ADDR
        int "Modbus address"
        range 1 127
        default 1
        help
            This is the Modbus slave address.

    config NGW_MODBUS_PORT
        int "Modbus port"
        range 1 65535
        default 502
        help
            This is the TCP port for Modbus.

    config NGW_ENABLE_WRITES
        bool "Warning: Enable write commands"
        default false
        help
            This option allows nibegw to relay Modbus register writes
            to the heatpump. It has been okay so far, but is still
            something to be treated with caution.

    config NGW_UDPLOG_ENABLE
        bool "Enable UDP logging"
        default false

    config NGW_UDPLOG_DST_ADDR
        string "UDP Log Address"
        help
            Destination address for the UDP log messages.

    config NGW_UDPLOG_DST_PORT
        int "UDP Log Port"
        range 1 65535
        help
            Destination port for the UDP log messages.

endmenu
```
